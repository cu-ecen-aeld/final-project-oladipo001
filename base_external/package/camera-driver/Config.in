## base_external/package/camera-driver/Config.in
```kconfig
config BR2_PACKAGE_CD
	bool "CD"
    	help
	  Includes the writer executable for CD
```

## base_external/package/ldd/Config.in
```kconfig
config BR2_PACKAGE_LDD
	bool "ldd"
    	help
	  Includes the writer executable for ldd
```
